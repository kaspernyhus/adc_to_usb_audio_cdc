## main/Kconfig.projbuild
```kconfig
menu "Audio configuration"
        config SIG_GEN_AUDIO_SOURCE
            bool "Enable Signal Generator"
            default n
            help
                Use signal generator as audio source
endmenu # Audio configuration
```

## sdkconfig.defaults
```kconfig
CONFIG_IDF_TARGET="esp32s3"
CONFIG_IDF_TARGET_ESP32S3=y


#
# Audio Device Class (UAC2)
#
CONFIG_TINYUSB_AUDIO_ENABLED=y
CONFIG_TINYUSB_AUDIO_SAMPLE_RATE=48000
# CONFIG_TINYUSB_AUDIO_16_BIT is not set
CONFIG_TINYUSB_AUDIO_24_BIT=y
# CONFIG_TINYUSB_AUDIO_1_CH is not set
CONFIG_TINYUSB_AUDIO_2_CH=y
# CONFIG_TINYUSB_AUDIO_4_CH is not set
CONFIG_TINYUSB_AUDIO_BYTES_PER_SAMPLE=3
CONFIG_TINYUSB_AUDIO_CHANNELS=2
# end of Audio Device Class (UAC2)


#
# Communication Device Class (CDC)
#
CONFIG_TINYUSB_CDC_ENABLED=y
CONFIG_TINYUSB_CDC_COUNT=1
CONFIG_TINYUSB_CDC_RX_BUFSIZE=512
CONFIG_TINYUSB_CDC_TX_BUFSIZE=512
# end of Communication Device Class (CDC)


#
# ESP Signal Generator
#
CONFIG_ENABLE_ESP_SIGNAL_GENERATOR=y
CONFIG_ESP_SIG_GEN_DEF_SAMPLE_RATE=48000
CONFIG_ESP_SIG_GEN_CHANNELS=2
CONFIG_ESP_SIG_GEN_DEF_VOLUME=40
# CONFIG_ESP_SIG_GEN_SINE is not set
CONFIG_ESP_SIG_GEN_SINE_TAB=y
# CONFIG_ESP_SIG_GEN_PINK_NOISE is not set
# CONFIG_ESP_SIG_GEN_SILENCE is not set
CONFIG_ESP_SIG_GEN_DEF_FREQ=440
CONFIG_ESP_SIG_GEN_DEF_FREQ_CH2=552
# CONFIG_ESP_SIG_GEN_16 is not set
# CONFIG_ESP_SIG_GEN_24 is not set
CONFIG_ESP_SIG_GEN_24_3=y
# CONFIG_ESP_SIG_GEN_32 is not set
CONFIG_ESP_SIG_GEN_LE=y
# CONFIG_ESP_SIG_GEN_BE is not set
CONFIG_ESP_SIG_GEN_INTERLEAVED=y
# CONFIG_ESP_SIG_GEN_NON_INTERLEAVED is not set
CONFIG_ESP_SIG_GEN_PULL=y
# CONFIG_ESP_SIG_GEN_PUSH is not set
# end of ESP Signal Generator
# end of Component config
```
